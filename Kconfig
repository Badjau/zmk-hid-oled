## Kconfig
```kconfig
if SHIELD_HID_OLED

# Required LVGL configs
config LV_Z_VDB_SIZE
    default 64

config LV_DPI_DEF
    default 148

config LV_Z_BITS_PER_PIXEL
    default 1

choice LV_COLOR_DEPTH
    default LV_COLOR_DEPTH_1
endchoice

choice ZMK_DISPLAY_WORK_QUEUE
    default ZMK_DISPLAY_WORK_QUEUE_DEDICATED
endchoice

choice ZMK_DISPLAY_STATUS_SCREEN
    default ZMK_DISPLAY_STATUS_SCREEN_CUSTOM
endchoice

config LV_Z_MEM_POOL_SIZE
    default 4096

# Enable ZMK's display support
config ZMK_DISPLAY
    default y

# Battery widget
config ZMK_WIDGET_BATTERY_STATUS
    default y

# Output (BLE/USB) status widget
config ZMK_WIDGET_OUTPUT_STATUS
    default y

# Layer status widget
config ZMK_WIDGET_LAYER_STATUS
    default y

endif # SHIELD_HID_OLED
    
```

## boards/shields/hid_oled/Kconfig.defconfig
```kconfig
if SHIELD_HID_OLED

# Required LVGL configs
config LV_Z_VDB_SIZE
    default 64

config LV_DPI_DEF
    default 148

config LV_Z_BITS_PER_PIXEL
    default 1

choice LV_COLOR_DEPTH
    default LV_COLOR_DEPTH_1
endchoice

choice ZMK_DISPLAY_WORK_QUEUE
    default ZMK_DISPLAY_WORK_QUEUE_DEDICATED
endchoice

choice ZMK_DISPLAY_STATUS_SCREEN
    default ZMK_DISPLAY_STATUS_SCREEN_CUSTOM
endchoice

config LV_Z_MEM_POOL_SIZE
    default 4096 if ZMK_DISPLAY_STATUS_SCREEN_CUSTOM

config ZMK_DISPLAY_STATUS_SCREEN_CUSTOM
    select HID_OLED_WIDGET_STATUS

config HID_OLED_GEM_WPM_FIXED_RANGE
    bool "Enable fixed range for WPM gauge/chart"
    default y

config HID_OLED_GEM_WPM_FIXED_RANGE_MAX
    int "Fixed range maximum for WPM gauge/chart"
    default 100

config HID_OLED_GEM_ANIMATION
    bool "Enable animation on peripheral"
    default y

config HID_OLED_GEM_ANIMATION_MS
    int "Animation length in milliseconds"
    default 960

config HID_OLED_WIDGET_STATUS
    select LV_USE_LABEL
    select LV_USE_IMG
    select LV_USE_CANVAS
    select LV_USE_ANIMIMG
    select LV_USE_ANIMATION

config HID_OLED_WIDGET_INVERTED
    bool "Invert display colors"

if !ZMK_SPLIT || ZMK_SPLIT_ROLE_CENTRAL

config HID_OLED_WIDGET_STATUS
    select ZMK_WPM

endif # !ZMK_SPLIT || ZMK_SPLIT_ROLE_CENTRAL

endif # SHIELD_HID_OLED
```
